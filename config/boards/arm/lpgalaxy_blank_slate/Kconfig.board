## config/boards/arm/lpgalaxy_blank_slate/Kconfig.board
```kconfig
# Blank Slate board configuration

# Copyright (c) 2021 Pete Johanson
# SPDX-License-Identifier: MIT

config BOARD_LPGALAXY_BLANK_SLATE
	bool "LP Galaxy Blank Slate"
	depends on SOC_NRF52840_QIAA
```

## config/boards/arm/lpgalaxy_blank_slate/Kconfig.defconfig
```kconfig
# Copyright (c) 2020 Pete Johanson
# SPDX-License-Identifier: MIT

if BOARD_LPGALAXY_BLANK_SLATE

config BOARD
	default "lpgalaxy_blank_slate"

config ZMK_KEYBOARD_NAME
	default "Blank Slate"

if USB

config USB_NRFX
	default y

config USB_DEVICE_STACK
	default y

endif # USB

config BT_CTLR
	default BT

config ZMK_BLE
	default y

config ZMK_USB
	default y

endif # BOARD_LPGALAXY_BLANK_SLATE
```

## config/west.yml
```yaml
manifest:
  remotes:
    - name: petejohanson
      url-base: https://github.com/petejohanson
    - name: zmkfirmware
      url-base: https://github.com/zmkfirmware
  projects:
    - name: zmk
      remote: zmkfirmware
      revision: v0.3
      import: app/west.yml
    - name: blank-slate-zmk-module
      remote: petejohanson
      revision: v0.3
  self:
    path: config
```
